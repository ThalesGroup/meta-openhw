## conf/layer.conf
```bitbake
# We have a conf and classes directory, add to BBPATH
BBPATH .= ":${LAYERDIR}"

# We have recipes-* directories, add to BBFILES
BBFILES += "${LAYERDIR}/recipes-*/*/*.bb \
            ${LAYERDIR}/recipes-*/*/*.bbappend"

BBFILE_COLLECTIONS += "meta-openhw"
BBFILE_PATTERN_meta-openhw = "^${LAYERDIR}/"
BBFILE_PRIORITY_meta-openhw = "6"

LAYERDEPENDS_meta-openhw = "core"
LAYERSERIES_COMPAT_meta-openhw = "honister"
```
